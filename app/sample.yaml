## app/sample.yaml
```yaml
sample:
  description: Firmware for wallckr robot
  name: wallckr 
common:
  build_only: true
  integration_platforms:
    - nucleo_f401re
    - nrf5340dk/nrf5340/cpuapp
tests:
  app.default: {}
```

## lib/Kconfig
```kconfig
menu "wallckr libraries"

config WALLCKR_MOTION
	bool "Support for wallckr Motion library"
	help
	  This option enables the wallckr Motion library

config WALLCKR_CONTROL
	bool "Support for wallckr Control library"
	help
	  This option enables the wallckr Control library

config WALLCKR_COMM
	bool "Support for wallckr Communication library"
	help
	  This option enables the wallckr Communication library

config WALLCKR_SENSING
	bool "Support for wallckr Communication library"
	help
	  This option enables the wallckr Communication library

endmenu
```

## lib/Motion/Kconfig
```kconfig
module = MOTION
module-str = motion
source "subsys/logging/Kconfig.template.log_config"
```

## tests/lib/Control/ExpFilter/testcase.yaml
```yaml
common:
  tags: extensibility
  integration_platforms:
    - nucleo_f401re
    - nrf5340dk/nrf5340/cpuapp
    - native_sim
tests:
  lib.control.expfilter: {}
```

## tests/lib/Motion/Motor/testcase.yaml
```yaml
common:
  tags: extensibility
  build_only: true
  integration_platforms:
    - nucleo_f401re
    - nrf5340dk/nrf5340/cpuapp
tests:
  lib.motion.motor: {}
```
