## CMakeLists.txt
```
zephyr_include_directories(lib/Robot)
zephyr_include_directories(lib/Communication)
zephyr_include_directories(lib/Control)
zephyr_include_directories(lib/Motion)
zephyr_include_directories(lib/Sensing)

#add_subdirectory(lib/Communication)
#add_subdirectory(lib/Motion)
#add_subdirectory(lib/Control)
#add_subdirectory(lib/Sensing)
add_subdirectory(lib)
```

## west.yml
```
# Copyright (c) 2021 Nordic Semiconductor ASA
# SPDX-License-Identifier: Apache-2.0

manifest:
  remotes:
    - name: zephyrproject-rtos
      url-base: https://github.com/zephyrproject-rtos

  projects:
    - name: zephyr
      remote: zephyrproject-rtos
      revision: v4.3.0
      import:
        # By using name-allowlist we can clone only the modules that are
        # strictly needed by the application.
        name-allowlist:
          - cmsis_6    # required by the ARM port
          - hal_stm32  # required by the nucleo_f401re board (STM32 based)
          - hal_nordic # required by the nrf5340dk_nrf5340_cpuapp board
```

## prj.conf
```kconfig
CONFIG_CPP=y
CONFIG_LOG=y
CONFIG_DEBUG=y
CONFIG_DEBUG_INFO=y
CONFIG_PWM=y
```

## boards/nucleo_f401re.overlay
```dts
/ {
    servo: servo {
        compatible = "pwm-servo";
        pwms = <&pwm2 1 PWM_MSEC(20) PWM_POLARITY_NORMAL>;
        min-pulse = <PWM_USEC(900)>;
        max-pulse = <PWM_USEC(2100)>;
    };
};

&pwm2 {
    pinctrl-0 = < &tim2_ch1_pa15 >;
};
```

## dts/bindings/pwm-motor.yaml
```yaml
description: PWM-driven DC motor.

compatible: "pwm-motor"

include: base.yaml

properties:
  pwms:
    required: true
    type: phandle-array
    description: PWM specifier driving the DC motor.
  ph-gpios:
    required: true
    type: phandle-array
    description: GPIO connected to DC motor PH pin.
    
  
```

## src/main.cpp
```c
#include "ArduinoBatterySensor.h"
#include "ArduinoBoardConfig.h"
#include "ArduinoCurrentSensor.h"
#include "ArduinoMotorController.h"
#include "ArduinoRobotIndicators.h"
#include "ArduinoSerialStream.h"
#include "ArduinoSteeringServo.h"
#include "ArduinoUltraSoundSensor.h"
#include "Battery.h"
#include "PollingRobotRunner.h"
#include "Robot.h"
#include "RobotPrinter.h"
#include <Arduino.h>

// cppcheck-suppress unusedFunction ; called by the Arduino core's own main()
void setup() {
  // Initialize serial communication representing wired UART over USB connection
  Serial.begin(115200);
  Serial.println("wallckr");

  // Initialize serial communication representing wireless Bluetooth Low Energy
  // (BLE) connection BLE module is connected to Serial3
  Serial3.begin(115200); // 9600 default

  // Issue AT command to set BLE module name to "wallckr"
  Serial3.write("AT NAMEwallckr\r\n");
}

// cppcheck-suppress unusedFunction ; called by the Arduino core's own main()
void loop() {

  ArduinoSerialStream arduino_serial_stream(Serial3);
  RobotPrinter BLE_out(arduino_serial_stream);
  ArduinoUltraSoundSensor sonar_front(TRIGGER_PIN_FRONT, ECHO_PIN_FRONT,
                                      MAX_DISTANCE_CM);
  ArduinoUltraSoundSensor sonar_right_front(
      TRIGGER_PIN_RIGHT_FRONT, ECHO_PIN_RIGHT_FRONT, MAX_DISTANCE_CM);
  ArduinoUltraSoundSensor sonar_right_center(
      TRIGGER_PIN_RIGHT_CENTER, ECHO_PIN_RIGHT_CENTER, MAX_DISTANCE_CM);
  DistanceSensors distance_sensors = {sonar_front, sonar_right_front,
                                      sonar_right_center};
  Sensing robot_sensing(distance_sensors, BLE_out);

  ArduinoBatterySensor battery_sensor;
  ArduinoCurrentSensor current_sensor;
  const int BATTERY_CELL_COUNT = 8;
  const int BATTERY_VOLTAGE_DIVIDER_FACTOR = 16;
  const uint16_t BATTERY_CELL_CUTOFF_mVDC = 900;
  const uint16_t BATTERY_PACK_CUTOFF_mVDC = BATTERY_CELL_CUTOFF_mVDC *
                                            BATTERY_CELL_COUNT /
                                            BATTERY_VOLTAGE_DIVIDER_FACTOR;
  const uint16_t BATTERY_HYSTERESIS_mVDC = 50;
  Battery robot_battery(battery_sensor, current_sensor, BLE_out,
                        BATTERY_PACK_CUTOFF_mVDC, BATTERY_HYSTERESIS_mVDC);

  ArduinoMotorController motor_controller(MOTOR_DIRECTION_PIN, MOTOR_PWM_PIN,
                                          MOTOR_BRAKE_PIN);
  ArduinoSteeringServo steering_servo(SERVO_PWM_PIN);
  Motion robot_motion(motor_controller, steering_servo);

  OvladackaParser ovladacka_parser;
  ExternalCommandDecoder external_command_decoder(arduino_serial_stream,
                                                  ovladacka_parser);

  constexpr int FILTER_N = 4;
  ExpFilter<int, FILTER_N> servo_cmd_filter;

  const int K_GAIN = 5;
  const int RIGHT_DISTANCE_SETPOINT_CM = 25;
  const int INSENSITIV_CM = 2;
  const int REGULATOR_ACTION_LIMIT_UP = 45;
  const int REGULATOR_ACTION_LIMIT_BOTTOM = -30;
  Regulator_P<int> side_distance_regulator(
      K_GAIN, RIGHT_DISTANCE_SETPOINT_CM, INSENSITIV_CM,
      REGULATOR_ACTION_LIMIT_UP, REGULATOR_ACTION_LIMIT_BOTTOM);
  ArduinoRobotIndicators robot_indicators;
  AutoSteering<int> wall_following_steering(
      RIGHT_DISTANCE_SETPOINT_CM, side_distance_regulator, servo_cmd_filter);

  Robot robot(robot_sensing, robot_battery, robot_motion,
              wall_following_steering, external_command_decoder,
              robot_indicators);

  PollingRobotRunner robot_runner(robot);

  while (true) {
    robot_runner.run_once(millis());
  }
}
```

## include/BLEPackets.h
```c
#ifndef BLEPACKETS_H
#define BLEPACKETS_H

#include <Arduino.h>

enum us_packet_ids {FRONT_US_ID = 100, RIGHT_FRONT_US_ID = 101, RIGHT_CENTER_US_ID = 102, RIGHT_BACK_US_ID = 103};
enum util_packet_ids {STATUS_ID = 80, MOTION_CMD_ID = 90};

// TODO: base class that provides virtual print, each packet will know how to print itself
/*

class robot_packet {
    public:
    virtual size_t print() = 0;
}

class sonar_packet {
    public:
    sonar_packet(byte id, unsigned long tick, unsigned long sonar_data)
    size_t print() override
    {
        // can this be common for all packets? ... this, sizeof(*this)???
        // but wait a minute, sizeof is evaluated at compile time so I cannot call it from the base class (it would always return the size of the base class)
        return m_BLE_serial.write((uint8_t*)&us_data, sizeof(us_data));
    }
}

*/


struct sonar_packet_t {
    byte id;
    unsigned long tick;
    unsigned long sonar_data;
    byte crc;
    };

// status packet, battery voltage, current, motor current? version ID?
struct status_packet_t {
    byte id;
    unsigned long tick;
    unsigned long version_ID; // long -> 4 bytes, instead of 8 chars
    unsigned int battery_voltage_adc; // analogRead() returns int; int is 2 bytes long on ATmega
    unsigned int total_currnet_adc;
    unsigned int motor_currnet_adc;
    byte crc;

    // FIXME probably not the best way of doing it
    status_packet_t()
    {
        version_ID = GIT_REV;
    };
    };

// motion command packet - srv and spd command
struct motion_command_packet_t {
    byte id;
    unsigned long tick;
    unsigned int servo_cmd; // int appropriate here? 
    signed int motor_cmd; // int appropriate here? 
    byte crc;

};


class BLE_printer
{
    HardwareSerial &m_BLE_serial;
public:
    BLE_printer(HardwareSerial &serial) : m_BLE_serial(serial) {};
    size_t BLE_print_US_data(byte id, unsigned long tick, unsigned long sonar_data);
    size_t BLE_print_status_data(byte id, unsigned long tick, unsigned int battery_adc);
    byte compute_xor_CRC(const uint8_t *buffer, size_t size);

};


#endif
```

## include/LEDBar.h
```c
#ifndef LED_BAR_H
#define LED_BAR_H

#include <Arduino.h>
// PA 2, ... PA 6
enum leds {LED1 = 24, LED2 = 25, LED3 = 26, LED4 = 27, LED5 = 28};

class LEDBar
{
private:
    /* data */
public:
    LEDBar(/* args */);
    ~LEDBar();
    void switchLEDon(unsigned int LED)
    {
        if(LED < LED1 || LED > LED5)
            return; 
        
        // TODO get rid of these arduino calls 
        digitalWrite(LED, 0);
    }

    void switchLEDoff(unsigned int LED)
    {
        if(LED < LED1 || LED > LED5)
            return; 
        
        digitalWrite(LED, 1);
    }
    
    /*void toggleLED(unsigned int LED)
    {
        // ... PINA = 1 << bit; 
    }*/

};

LEDBar::LEDBar(/* args */)
{
    // TODO get rid of Arduino calls 
    pinMode(LED1, OUTPUT);
    pinMode(LED2, OUTPUT);
    pinMode(LED3, OUTPUT);
    pinMode(LED4, OUTPUT);
    pinMode(LED5, OUTPUT);

    digitalWrite(LED1, 1);
    digitalWrite(LED2, 1);
    digitalWrite(LED3, 1);
    digitalWrite(LED4, 1);
    digitalWrite(LED5, 1);
}

LEDBar::~LEDBar()
{
}


#endif
```

## include/Motion.h
```c
#ifndef MOTION_H
#define MOTION_H

#include <Arduino.h>
#include <Servo.h>
#include "BLEJoystickDecoder.h"


// Pin definitions 
const int PWM_A   = 3;
const int DIR_A   = 12;
const int SERVO_A = 47;

// Servo motion definitions 
const int SERVO_INCREMENT = 10;
const int SERVO_CENTER = 80;
const int SERVO_MIN_RIGHT = 20;
const int SERVO_MAX_LEFT = 160;

// Motor definitions 
const int MAX_SPD = 255;
const int SPD_INCREMENT = 50;

class Motion
{
    int m_prev_speed;
    int m_oldServo;
    Servo m_steering_servo;
    bool m_disabled;

public:

    Motion() : m_prev_speed(0), m_oldServo(SERVO_CENTER), m_disabled(false)
    {
        m_steering_servo.attach(SERVO_A);

        // Direction pin on channel A
        pinMode(DIR_A, OUTPUT);  
    }

    bool setSpeed(int spd);
    bool setAngle(int angle);
    bool Stop() { return setSpeed(0); }
    bool set_speed_and_angle(int spd, int angle);
    bool command(command_t cmd, int &spd, int &angle);
    void disable() 
    {
        Stop();
        m_disabled = true; 
    }
    void enable() { m_disabled = false; }
};

#endif
```

## include/Sensing.h
```c
#ifndef SENSING_H
#define SENSING_H

#include <Arduino.h>
#include "UltraSoundSensor.h"

class Sensing
{
    // battery related constants 
    static const int BATTERY_CELLS = 8;
    static const int BATTERY_CUTTOFF_ADC = (0.9 / 5 * 1024 * BATTERY_CELLS) / 16;
    static const int SNS_BATTERY_VLTG = A8;

    // sonar related constants
    static const int TRIGGER_PIN_FRONT = 32;  // Arduino pin tied to trigger pin on the ultrasonic sensor.
    static const int ECHO_PIN_FRONT = 33;  // Arduino pin tied to echo pin on the ultrasonic sensor.

    static const int TRIGGER_PIN_RIGHT_FRONT = 34;
    static const int ECHO_PIN_RIGHT_FRONT = 35;

    static const int TRIGGER_PIN_RIGHT_CENTER = 36;
    static const int ECHO_PIN_RIGHT_CENTER = 37;

    static const int MAX_DISTANCE = 200; // TODO: rename to MAX_DISTANCE_CM

    UltraSoundSensor sonar_front; //(TRIGGER_PIN_FRONT, ECHO_PIN_FRONT, MAX_DISTANCE);
    UltraSoundSensor sonar_right_front; //(TRIGGER_PIN_RIGHT_FRONT, ECHO_PIN_RIGHT_FRONT, MAX_DISTANCE);
    UltraSoundSensor sonar_right_center; //(TRIGGER_PIN_RIGHT_CENTER, ECHO_PIN_RIGHT_CENTER, MAX_DISTANCE);

public:
    // TODO reference to printer? 
    Sensing() : sonar_front(TRIGGER_PIN_FRONT, ECHO_PIN_FRONT, MAX_DISTANCE),
                sonar_right_front(TRIGGER_PIN_RIGHT_FRONT, ECHO_PIN_RIGHT_FRONT, MAX_DISTANCE),
                sonar_right_center(TRIGGER_PIN_RIGHT_CENTER, ECHO_PIN_RIGHT_CENTER, MAX_DISTANCE) {};
    
    bool battery_voltage_ok(); 
    unsigned int get_side_distance_cm();
    unsigned int get_front_distance_cm();

};

#endif // SENSING_H
```

## include/UltraSoundSensor.h
```c
#ifndef ULTRASOUNT_SENSOR_H
#define ULTRASOUNT_SENSOR_H

#include <NewPing.h>
#include "Regulator.h"

class UltraSoundSensor
{
    unsigned long m_measurement_raw_cm;
    unsigned long m_measurement_filtered_cm;
    unsigned int m_max_cm_distance;

    NewPing m_sonar;
    const int FILTER_N = 4; 
    ExpFilter<int> m_sonar_filter = ExpFilter<int>(FILTER_N);

    public:

    UltraSoundSensor(uint8_t trigger_pin, uint8_t echo_pin, unsigned int max_cm_distance) :  m_max_cm_distance(max_cm_distance) ,
    m_sonar(trigger_pin, echo_pin, max_cm_distance)
    {};

    bool trigger_measuremen()
    {
        m_measurement_raw_cm = m_sonar.ping_cm();
        
        // Zero means out of range -> change the library, so I can distinguish actual zero and out of range?
        if(m_measurement_raw_cm == 0)  
        {
            m_measurement_raw_cm = m_max_cm_distance;
        }        

        return true;
    }
    
    unsigned long get_distance_raw_cm()
    {
        trigger_measuremen();

        return m_measurement_raw_cm;
    }
    
    unsigned long get_distance_filtered_cm()
    {
        trigger_measuremen();

        m_measurement_filtered_cm = m_sonar_filter.next(m_measurement_raw_cm);

        return m_measurement_filtered_cm;
    }
};

#endif
```

## src/ArduinoBoardConfig.h
```c
#ifndef ARUDINO_BOARD_CONFIG_H
#define ARUDINO_BOARD_CONFIG_H

// Pin definitions
// Motion control pins
constexpr int MOTOR_PWM_PIN = 3;
constexpr int MOTOR_DIRECTION_PIN = 12;
constexpr int SERVO_PWM_PIN = 47;
constexpr int MOTOR_BRAKE_PIN = 9;

// Ultrasonic sensor pins
constexpr int TRIGGER_PIN_FRONT = 32;
constexpr int ECHO_PIN_FRONT = 33;

constexpr int TRIGGER_PIN_RIGHT_FRONT = 34;
constexpr int ECHO_PIN_RIGHT_FRONT = 35;

constexpr int TRIGGER_PIN_RIGHT_CENTER = 36;
constexpr int ECHO_PIN_RIGHT_CENTER = 37;

#endif // ARUDINO_BOARD_CONFIG_H
```

## src/BLEJoystickDecoder.cpp
```c
#include "BLEJoystickDecoder.h"
#include "Motion.h"

command_t BLEJoystickDecoder::input_to_command(char in)
{
  command_t command = NO_COMMAND;

  switch(in)
  {
    case 'a':
      command = UP;
    break;
    case 'b':
      command = RIGHT;
    break;
    case 'c':
      command = DOWN;
    break;
    case 'd':
      command = LEFT;
    break;
    case 'e':
      command = UP_TRIANGLE;
    break;
    case 'f':
      command = RIGHT_CIRCLE;
    break;
    case 'g':
      command = DOWN_X;
    break;
    case 'h':
      command = LEFT_SQUARE;
    break;

  }

  return command; 
}

// decoding commands from BLE joystick Iphone app which sends commands in
// format "Aa\0" -> Upper case, lower case, zero for each button press ->
// buttons are labled from A to H
command_t BLEJoystickDecoder::command_decoder()
{
  command_t command = NO_COMMAND; 
  char current, prev;
  bool waiting4zero = false;
  const int DIFF_LOWER_UPPER = 'a' - 'A';

  while(!m_cmdSerial.available())
  {
    ;
  }

  prev = m_cmdSerial.read();

  while(command == NO_COMMAND) 
  {
    while(!m_cmdSerial.available())
    {
      ;
    }
    
    current = m_cmdSerial.read();

    if(waiting4zero)
    {

      
      if(current == 0)
      {
        command = input_to_command(prev);
      }
      else
      {
        waiting4zero = false;
      }
      
    }
    else if(current - prev == DIFF_LOWER_UPPER) 
    {
      waiting4zero = true;
    }

    prev = current; 
  }

  return command; 
  
}

command_t BLEJoystickDecoder::command_decoder_fast()
{
  command_t command = NO_COMMAND; 
  char current, prev;
  const int DIFF_LOWER_UPPER = 'a' - 'A';

  while(!m_cmdSerial.available())
  {
    ;
  }

  prev = m_cmdSerial.read();

  while(command == NO_COMMAND) 
  {
    while(!m_cmdSerial.available())
    {
      ;
    }
    
    current = m_cmdSerial.read();
    
    if(current - prev == DIFF_LOWER_UPPER) 
    {
      command = input_to_command(current);
    }

    prev = current; 
  }

  return command; 
  
}

command_t BLEJoystickDecoder::command_decoder_fastest()
{
  command_t command = NO_COMMAND; 
  char current;
  const int DIFF_LOWER_UPPER = 'a' - 'A';

  if(m_cmdSerial.available()) 
  {  
    current = m_cmdSerial.read();

    if(current < 'a') // if upperacase
    {
      current += DIFF_LOWER_UPPER;  // make it lower case
    }
    
    command = input_to_command(current);
  }

  return command; 
  
}

bool BLEJoystickDecoder::check_motion_cmd(int &desired_speed, int &desired_servo_angle)
{
    command_t incomming_cmd = command_decoder_fastest();

    if(incomming_cmd != NO_COMMAND)
    {
      switch(incomming_cmd)
      {
        case UP:
          if(desired_speed < MAX_SPD)
          {
            desired_speed += SPD_INCREMENT;
          }
        break;
        case DOWN:
          if(desired_speed > -MAX_SPD)
          {
            desired_speed -= SPD_INCREMENT;
          }
        break;
        case RIGHT:
          if(desired_servo_angle > SERVO_MIN_RIGHT)
          {
            desired_servo_angle -= SERVO_INCREMENT;
          }
        break;
        case LEFT:
          if(desired_servo_angle < SERVO_MAX_LEFT)
          {
            desired_servo_angle += SERVO_INCREMENT;
          }
        break;
        case UP_TRIANGLE:
          desired_servo_angle = SERVO_CENTER;
        break;
        default:
          desired_speed = 0; 
      }
    }

    return true; 

}
```

## src/BLEJoystickDecoder.h
```c
#ifndef BLEJOYSTICKDECODER_H
#define BLEJOYSTICKDECODER_H

#include "Arduino.h"

enum command_t {NO_COMMAND = 0, UP, RIGHT, DOWN, LEFT, UP_TRIANGLE, RIGHT_CIRCLE, DOWN_X, LEFT_SQUARE }; 

class BLEJoystickDecoder
{
    HardwareSerial &m_cmdSerial;
    command_t input_to_command(char in);
    command_t command_decoder();
    command_t command_decoder_fast();
    command_t command_decoder_fastest();

public: 

    BLEJoystickDecoder(HardwareSerial &cmdSerial) : m_cmdSerial(cmdSerial) {};
    bool check_motion_cmd(int &desired_speed, int &desired_servo_angle);
};
#endif // BLEJOYSTICKDECODER_H
```

## src/BLEPackets.cpp
```c
#include "BLEPackets.h"

size_t BLE_printer::BLE_print_US_data(byte id, unsigned long tick, unsigned long sonar_data)
{
    sonar_packet_t us_data;

    us_data.id = id;
    us_data.sonar_data = sonar_data;
    us_data.tick = tick;
    
    // TODO add CRC_and_send function
    us_data.crc = compute_xor_CRC((uint8_t*)&us_data, sizeof(us_data));
    
    return m_BLE_serial.write((uint8_t*)&us_data, sizeof(us_data));
}

size_t BLE_printer::BLE_print_status_data(byte id, unsigned long tick, unsigned int battery_adc)
{
    status_packet_t status_data;

    status_data.id = id;
    status_data.tick = tick;
    
    status_data.battery_voltage_adc = battery_adc;
    status_data.total_currnet_adc = 0; // FIXME
    status_data.motor_currnet_adc = 0; // FIXME

    // TODO add CRC computation
    status_data.crc = compute_xor_CRC((uint8_t*)&status_data, sizeof(status_data));
    
    return m_BLE_serial.write((uint8_t*)&status_data, sizeof(status_data));
}

// TODO: verify this does not introduce too much delay to control loop
byte BLE_printer::compute_xor_CRC(const uint8_t *buffer, size_t size)
{     
    byte CRC = 0;

    if(size)
    {
        CRC = buffer[0];

        // (size - 1) -> don't include the last byte - the CRC byte
        for(unsigned int i = 1; i < (size - 1); i++)
        {
            CRC ^= buffer[i];
        }
    }

    return CRC;
}
```

## src/BLEPackets.h
```c
#ifndef BLEPACKETS_H
#define BLEPACKETS_H

#include <Arduino.h>

enum us_packet_ids {FRONT_US_ID = 100, RIGHT_FRONT_US_ID = 101, RIGHT_CENTER_US_ID = 102, RIGHT_BACK_US_ID = 103};
enum util_packet_ids {STATUS_ID = 80, MOTION_CMD_ID = 90};

struct sonar_packet_t {
    byte id;
    unsigned long tick;
    unsigned long sonar_data;
    byte crc;
    };

// status packet, battery voltage, current, motor current? version ID?
struct status_packet_t {
    byte id;
    unsigned long tick;
    unsigned long version_ID; // long -> 4 bytes, instead of 8 chars
    unsigned int battery_voltage_adc; // analogRead() returns int; int is 2 bytes long on ATmega
    unsigned int total_currnet_adc;
    unsigned int motor_currnet_adc;
    byte crc;

    // FIXME probably not the best way of doing it
    status_packet_t()
    {
        version_ID = GIT_REV;
    };
    };

// motion command packet - srv and spd command
struct motion_command_packet_t {
    byte id;
    unsigned long tick;
    unsigned int servo_cmd; // int appropriate here? 
    signed int motor_cmd; // int appropriate here? 
    byte crc;

};


class BLE_printer
{
    HardwareSerial &m_BLE_serial;
public:
    BLE_printer(HardwareSerial &serial) : m_BLE_serial(serial) {};
    size_t BLE_print_US_data(byte id, unsigned long tick, unsigned long sonar_data);
    size_t BLE_print_status_data(byte id, unsigned long tick, unsigned int battery_adc);
    byte compute_xor_CRC(const uint8_t *buffer, size_t size);

};


#endif
```

## src/CRegulator.cpp
```c
#include "CRegulator.h"


template<> int ExpFilter<int>::core(int input)
{
    if (m_N == 4)
    {
        //=BITRSHIFT(BITLSHIFT(F3, 2) - F3 + C5 + 2, 2)
        // 3/4 * state + 1/4 * input
        // (4*state - state + input + rounding_constatnt) / 4
        // WARNING: This never converges to zero! It gets stuck at 2
        return ((m_state << 2) - m_state + input + 2) >> 2; 
    }
    else
    {
        // TODO: Testing needed 
        return (((m_N - 1) * 100 / m_N) * m_state + 100/m_N * input) / 100; 
    }
}

template<> float ExpFilter<float>::core(float input)
{
    // 0.75 * m_state + 0.25 * input;
    if (m_N == 4)
    {
        return 0.75 * m_state + 0.25 * input;
    }
    else
    {
        return ((m_N - 1.0) / m_N) * m_state + 1.0/m_N * input;  
    }
}
```

## src/CRegulator.h
```c
// incl guard
#ifndef CREGULATOR_H
#define CREGULATOR_H


// Regulator interface 
template <typename T>
class Regulator
{
protected:
    T m_gain;

    T m_setpoint;
    T m_insensitivity;
    
    // FIXME this should be also an input
    const T m_action_limit_up = 45;  
    const T m_action_limit_bottom = -30; 

    virtual T regulator_equation(T e) = 0;

public:
    Regulator(T gain, T setpoint, T insen) : m_gain(gain), m_setpoint(setpoint), m_insensitivity(insen) {}; 
    virtual T action(T in)
    {        
        T e = this->m_setpoint - in;
        T out = 0;

        if (e > this->m_insensitivity || e < -this->m_insensitivity)
        {
            out = regulator_equation(e);  
        }
        
        if (out > this->m_action_limit_up)
        {
            out = this->m_action_limit_up;
        }
        else if (out < this->m_action_limit_bottom)
        {
            out = this->m_action_limit_bottom;
        }

        return out;    
    }
};

template <typename T>
class Regulator_P : public Regulator<T>
{
    protected:
    T regulator_equation(T e) override
    {
        return this->m_gain * e;
    }

    public:
    Regulator_P(T gain, T setpoint, T insen) : Regulator<T>(gain, setpoint, insen) {}; 
    
}; 

template <typename T>
class Regulator_PD : public Regulator<T>
{
    protected:
    T m_D_gain;
    bool m_first_run; 
    T m_last_e;

    T regulator_equation(T e) override
    {
        if(m_first_run)
        {
            m_first_run = false;
            m_last_e = e; 
        }

        return this->m_gain * e + (e - m_last_e) * m_D_gain;
    }

    public:
    Regulator_PD(T gain, T D_gain, T setpoint, T insen) : Regulator<T>(gain, setpoint, insen), m_D_gain(D_gain), m_first_run(true), m_last_e(0) {}; 
   
}; 


template <typename T> class ExpFilter
{
private:
    T m_state;
    bool m_first_step;
    const int m_N; 
    T core(T input);
public:
    ExpFilter(int N) : m_state(0), m_first_step(true), m_N(N) {};
    T next(T input)
    {
        if(m_first_step)
        {
            m_first_step = false;
            m_state = input;                  
        }
        else
        {
            m_state = core(input); 
        }
            
        return m_state;  
    }
};


#endif
```
